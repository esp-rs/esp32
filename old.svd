# Espressif register map
File version: 1.0
CPU: Xtensa LX6 1, little endian, no MPU, FPU, 3 interrupt priority bits
Registers are 32-bit, access not given, reset 0x0 unless marked. A register's access mark holds for its fields unless they carry their own. Offsets are from the block's base; lines under a group give offsets from that group; [hi:lo] are bit positions; {n}, {i} and the like mark numbered series; 'fields as' and 'values as' point back to an identical list; <NAME> marks a mode.

## Memory map
0x00000000 SPI size 0x860
0x00000000 I2C size 0x4C0
0x00000000 UHCI size 0x620
0x00000000 TIMG size 0x580
0x00000000 MCPWM size 0x940
0x00000000 PWM0 size 0x940
0x00000000 I2C0 size 0x4C0
0x00000000 I2C1 size 0x4C0
0x00000000 XTENSA
0x00000000 WIFI_MAC
0x00000000 WIFI_BB
0x00000000 BT_MAC
0x00000000 BT_BB
0x00000000 RW_BT
0x00000000 RW_BLE
0x00000000 ETH_MAC
0x00000000 SDIO
0x00000000 ETH
0x00000000 WDT
0x3FF00000 DPORT size 0x2DE0
0x3FF01000 AES
0x3FF02000 RSA
0x3FF03000 SHA
0x3FF40000 UART size 0x3A0
0x3FF42000 SPI1 size 0x860
0x3FF43000 SPI0 size 0x860
0x3FF44000 GPIO size 0x2E60
0x3FF44F00 GPIO_SD size 0x160
0x3FF45000 FE2
0x3FF46000 FE
0x3FF47000 FRC_TIMER
0x3FF48000 RTCCNTL size 0x6A0
0x3FF48400 RTCIO size 0x660
0x3FF48800 SENS size 0x540
0x3FF48C00 RTC_I2C size 0x160
0x3FF49000 IO_MUX
0x3FF4B000 HINF size 0x1A0
0x3FF4C000 UHCI1 size 0x620
0x3FF4F000 I2S size 0x5A0
0x3FF50000 UART1
0x3FF50000 UART0
0x3FF51000 BT
0x3FF53000 I2C_EXT
0x3FF54000 UHCI0 size 0x620
0x3FF55000 SLCHOST size 0x800
0x3FF56000 RMT size 0x6C0
0x3FF57000 PCNT size 0x5C0
0x3FF58000 SLC size 0xA60
0x3FF59000 LEDC size 0xCC0
0x3FF5A000 EFUSE size 0x920
0x3FF5B000 SPI_ENCRYPT
0x3FF5CC00 NRX
0x3FF5D000 BB
0x3FF5E000 PWM
0x3FF5F000 TIMERGROUP0
0x3FF5F000 TIMG0 size 0x580
0x3FF60000 TIMERGROUP1
0x3FF60000 TIMG1 size 0x580
0x3FF61000 RTCMEM0
0x3FF62000 RTCMEM1
0x3FF63000 RTCMEM2
0x3FF64000 SPI2 size 0x860
0x3FF65000 SPI3 size 0x860
0x3FF66000 APB_CTRL size 0x220
0x3FF66000 SYSCON size 0x220
0x3FF67000 I2C1_EXT
0x3FF68000 SDMMC
0x3FF69000 EMAC
0x3FF6B000 CAN
0x3FF6C000 PWM1 size 0x940
0x3FF6D000 I2S1
0x3FF6E000 UART2
0x3FF6F000 PWM2 size 0x940
0x3FF70000 PWM3 size 0x940

## Interrupts
0 WIFI_MAC_INTR (WIFI_MAC) — interrupt of WiFi MAC, level
1 WIFI_MAC_NMI (WIFI_MAC) — interrupt of WiFi MAC, NMI, use if MAC have bug to fix in NMI
2 WIFI_BB_INTR (WIFI_BB) — interrupt of WiFi BB, level, we can do some calibration
3 BT_MAC_INTR (BT_MAC) — will be cancelled
4 BT_BB_INTR (BT_BB) — interrupt of BT BB, level
5 BT_BB_NMI (BT_BB) — interrupt of BT BB, NMI, use if BB have bug to fix in NMI
8 RWBT_NMI (RW_BT) — interrupt of RWBT, NMI, use if RWBT have bug to fix in NMI
9 RWBLE_NMI (RW_BLE) — interrupt of RWBLE, NMI, use if RWBT have bug to fix in NMI
10 SLC0_INTR (SLC) — interrupt of SLC0, level
11 SLC1_INTR (SLC) — interrupt of SLC1, level
12 UHCI0_INTR (UHCI0) — interrupt of UHCI0, level
13 UHCI1_INTR (UHCI1) — interrupt of UHCI1, level
22 GPIO_INTR (GPIO) — interrupt of GPIO, level
23 GPIO_NMI (GPIO) — interrupt of GPIO, NMI
28 SPI0_INTR (SPI0) — interrupt of SPI0, level, SPI0 is for Cache Access, do not use this
32 I2S0_INTR (I2S) — interrupt of I2S0, level
33 I2S1_INTR (I2S) — interrupt of I2S1, level
34 UART0_INTR (UART0) — interrupt of UART0, level
35 UART1_INTR (UART1) — interrupt of UART1, level
36 UART2_INTR (UART2) — interrupt of UART2, level
37 SDIO_HOST_INTR (SDIO) — interrupt of SD/SDIO/MMC HOST, level
38 ETH_MAC_INTR (ETH) — interrupt of ethernet mac, level
39 PWM0_INTR (PWM0) — interrupt of PWM0, level, Reserved
40 PWM1_INTR (PWM1) — interrupt of PWM1, level, Reserved
41 PWM2_INTR (PWM2) — interrupt of PWM2, level
42 PWM3_INTR (PWM3) — interrupt of PWM3, level
43 LEDC_INTR (LEDC) — interrupt of LED PWM, level
44 EFUSE_INTR (EFUSE) — interrupt of efuse, level, not likely to use
45 CAN_INTR (CAN) — interrupt of can, level
46 RTC_CORE_INTR (RTCCNTL) — interrupt of rtc core, level, include rtc watchdog
47 RMT_INTR (RMT) — interrupt of remote controller, level
48 PCNT_INTR (PCNT) — interrupt of pluse count, level
49 I2C_EXT0_INTR (I2C0) — interrupt of I2C controller0, level
50 I2C_EXT1_INTR (I2C1) — interrupt of I2C controller1, level
51 RSA_INTR (RSA) — interrupt of RSA accelerator, level
52 SPI1_DMA_INTR (SPI1) — interrupt of SPI1 DMA, SPI1 is for flash read/write, do not use this
53 SPI2_DMA_INTR (SPI2) — interrupt of SPI2 DMA, level
54 SPI3_DMA_INTR (SPI3) — interrupt of SPI3 DMA, level
55 WDT_INTR (WDT) — will be cancelled
58 TG0_T0_EDGE_INTR (TIMG0) — interrupt of TIMER_GROUP0, TIMER0, EDGE
59 TG0_T1_EDGE_INTR (TIMG0) — interrupt of TIMER_GROUP0, TIMER1, EDGE
60 TG0_WDT_EDGE_INTR (TIMG0) — interrupt of TIMER_GROUP0, WATCH DOG, EDGE
61 TG0_LACT_EDGE_INTR (TIMG0) — interrupt of TIMER_GROUP0, LACT, EDGE
62 TG1_T0_EDGE_INTR (TIMG1) — interrupt of TIMER_GROUP1, TIMER0, EDGE
63 TG1_T1_EDGE_INTR (TIMG1) — interrupt of TIMER_GROUP1, TIMER1, EDGE
64 TG1_WDT_EDGE_INTR (TIMG1) — interrupt of TIMER_GROUP1, WATCHDOG, EDGE
65 TG1_LACT_EDGE_INTR (TIMG1) — interrupt of TIMER_GROUP0, LACT, EDGE
66 MMU_IA_INTR (XTENSA) — interrupt of MMU Invalid Access, LEVEL
67 MPU_IA_INTR (XTENSA) — interrupt of MPU Invalid Access, LEVEL
68 CACHE_IA_INTR (XTENSA) — interrupt of Cache Invalid Access, LEVEL
